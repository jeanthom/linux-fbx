## drivers/media/platform/tango2/Kconfig
```kconfig
config DVB_TANGO2
	tristate "Tango2 DVB adapter"
	depends on ARCH_FBX5_B
	select I2C
	select I2C_ALGOBIT
	select DVB_TDA1004X
	select DVB_PLL

config DVB_TANGO2_TESTBED
	bool "extended testing and useful error codes"
	depends on DVB_TANGO2
```

## drivers/misc/hdmi-cec/Kconfig
```kconfig
menu "HDMI CEC support"

config HDMI_CEC
	tristate "HDMI CEC (Consumer Electronics Control) support"
	---help---
	   HDMI Consumer Electronics Control support.

config HDMI_CEC_REMOTI
	tristate "RemoTI CEC driver"
	depends on HDMI_CEC
	select REMOTI
	---help---
	   HDMI CEC driver using RemoTI IPCs.

endmenu
```

## drivers/misc/remoti/Kconfig
```kconfig
menu "RemoTI support"

config REMOTI
	tristate "RemoTI support"
	depends on FBX6HD
	---help---
	  Texas Instruments RemoTI stack.

config REMOTI_LEDS
	tristate "RemoTI LEDS support"
	depends on REMOTI
	depends on LEDS_CLASS
	---help---
	  RemoTI LEDS class driver support.

config REMOTI_GPIO
	tristate "RemoTI gpio support"
	depends on REMOTI
	---help---
	  gpiochip driver for the RemoTI RNP

config REMOTI_USER
	tristate "RemoTI userspace access"
	depends on REMOTI

endmenu
```

## drivers/net/ethernet/sigma/Kconfig
```kconfig
#
# Marvell device configuration
#

config NET_VENDOR_SIGMA
	bool "Sigma Design devices"
	default y
	depends on TANGO2

if NET_VENDOR_SIGMA

config TANGO2_ENET
	tristate "SMP863x Builtin Ethernet support"
	select MII
	select CRC32
	help
	 This option adds support for the SMP863x integrated Ethernet
	 controller.  This driver uses NAPI and generic Linux MII
	 support.

endif # NET_VENDOR_SIGMA
```

## drivers/net/ethernet/wintegra/Kconfig
```kconfig
config NET_VENDOR_WINTEGRA
	bool

config WINTEGRA_WINPATH3_ETH
	tristate "Wintegra Winpath3 internal mac support"
	depends on WINTEGRA_WINPATH3
	select NET_VENDOR_WINTEGRA
	select NET_CORE
	select MII
	select PHYLIB
```

## drivers/platform/Kconfig
```kconfig
if X86
source "drivers/platform/x86/Kconfig"
endif
if MIPS
source "drivers/platform/mips/Kconfig"
endif
if GOLDFISH
source "drivers/platform/goldfish/Kconfig"
endif

source "drivers/platform/chrome/Kconfig"

if X86_INTEL_CE
source "drivers/platform/intelce/Kconfig"
endif

if TANGO2
source "drivers/platform/tango2/Kconfig"
endif
```

## drivers/platform/intelce/Kconfig
```kconfig
#
# IntelCE devices configuration
#

menu "IntelCE devices"

config INTELCE_GPIO
	tristate "GPIO support"
	select ARCH_REQUIRE_GPIOLIB
	---help---
	  IntelCE 3100/4100 GPIO support.

config INTELCE_DFX
	tristate "DFX reporting support"
	---help---
	  IntelCE 3100/4100 DFX fuse reporting support.

endmenu
```

## drivers/platform/tango2/Kconfig
```kconfig
#
# TANGO2 devices configuration
#

menu "Tango2 devices"
	depends on TANGO2

config TANGO2_FIP
	tristate "Front panel support"
	select INPUT
	---help---
	  Tango2 FIP front panel support.

config TANGO2_GPIO
	tristate "GPIO sysfs support"
	---help---
	  Export GPIO attributes in sysfs.

config TANGO2_IR
	tristate "IR support"
	---help---
	  Tango2 IR (NEC/RC5/RC6) support.

config TANGO2_FB
	tristate "Framebuffer support"
	depends on FB
	---help---
	  Tango2 framebuffer support.

endmenu
```

## drivers/video/Kconfig
```kconfig
#
# Video configuration
#

menu "Graphics support"
	depends on HAS_IOMEM

config HAVE_FB_ATMEL
	bool

config SH_MIPI_DSI
	tristate
	depends on (SUPERH || ARCH_SHMOBILE) && HAVE_CLK

config SH_LCD_MIPI_DSI
	bool

source "drivers/char/agp/Kconfig"

source "drivers/gpu/vga/Kconfig"

source "drivers/gpu/host1x/Kconfig"
source "drivers/gpu/ipu-v3/Kconfig"

source "drivers/gpu/drm/Kconfig"

menu "Frame buffer Devices"
source "drivers/video/fbdev/Kconfig"
endmenu

source "drivers/video/backlight/Kconfig"

config VGASTATE
       tristate
       default n

config VIDEOMODE_HELPERS
	bool

config HDMI
	bool

if VT
	source "drivers/video/console/Kconfig"
endif

if FB || SGI_NEWPORT_CONSOLE
	source "drivers/video/logo/Kconfig"

endif


config FB_SSD1327
	tristate "SSD1327 OLED driver"
	depends on FB
	select FB_SYS_FILLRECT
	select FB_SYS_COPYAREA
	select FB_SYS_IMAGEBLIT
	select FB_SYS_FOPS
	select FB_BACKLIGHT
	select SPI
	default n

endmenu
```

## sound/soc/kirkwood/Kconfig
```kconfig
config SND_KIRKWOOD_SOC
	tristate "SoC Audio for the Marvell Kirkwood and Dove chips"
	depends on ARCH_DOVE || ARCH_MVEBU || COMPILE_TEST
	help
	  Say Y or M if you want to add support for codecs attached to
	  the Kirkwood I2S interface. You will also need to select the
	  audio interfaces to support below.

config SND_KIRKWOOD_SOC_ARMADA370_DB
	tristate "SoC Audio support for Armada 370 DB"
	depends on SND_KIRKWOOD_SOC && (ARCH_MVEBU || COMPILE_TEST) && I2C
	select SND_SOC_CS42L51
	select SND_SOC_SPDIF
	help
	  Say Y if you want to add support for SoC audio on
	  the Armada 370 Development Board.

config SND_KIRKWOOD_SOC_FBXGW2R
	tristate "Soc Audio support for fbxgw2r"
	depends on SND_KIRKWOOD_SOC && MACH_FBXGW2R && I2C
	select SND_KIRKWOOD_SOC_I2S
	select SND_SOC_CS42L52
```
